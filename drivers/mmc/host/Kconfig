## drivers/mmc/host/Kconfig
```kconfig
#
# MMC/SD host controller drivers
#

comment "MMC/SD Host Controller Drivers"

config MMC_ARMMMCI
	tristate "ARM AMBA Multimedia Card Interface support"
	depends on ARM_AMBA
	help
	  This selects the ARM(R) AMBA(R) PrimeCell Multimedia Card
	  Interface (PL180 and PL181) support.  If you have an ARM(R)
	  platform with a Multimedia Card slot, say Y or M here.

	  If unsure, say N.
	  
config MMC_S3C
	tristate "Samsung S3C Multimedia Card Interface support"
	select MMC_BLOCK
	select MMC_SUPPORT_MOVINAND
	depends on ARCH_S3C2410 && MMC && !(CPU_S3C6400 || CPU_S3C6410)
	help
	  This selects the Samsung S3C Multimedia Card Interface
	  support.

	  If unsure, say N.

config HSMMC_S3C
	tristate "Samsung S3C High Speed MMC Interface support"
	select MMC_BLOCK
	select MMC_SUPPORT_MOVINAND
	depends on (CPU_S3C2443 || CPU_S3C2450 || CPU_S3C2416 || CPU_S3C6400 || CPU_S3C6410) && MMC
	help
	  This selects the Samsung S3C Multimedia Card Interface
	  support.

	  If unsure, say N.

config USE_MMC_AS_ROOT
	bool "MMC can be used as a Root Filesystem Device"
	depends on HSMMC_S3C && !MACH_SANJOSE2
	default y
	help
	  Say Y here when you want to use MMC as a root file system.

config HSMMC_S3C_IRQ_WORKAROUND
	bool "Fix IRQ Hanging in HS-MMC"
	depends on HSMMC_S3C
	default y
	help
	  Say Y here when you are using S3C6400 or S3C6410.

config HSMMC_SCATTERGATHER
	bool "Support Scatter and Gather in HS-MMC"
	depends on HSMMC_S3C
	help
	  Say Y here. This option can support scatter and gather
	  using DMA boundary in HS-MMC DMA engine.

config MMC_SUPPORT_MOVINAND
	bool "Support moviNAND from Samsung Electronics"
	depends on (MMC_S3C || HSMMC_S3C) && MMC
	help
	  Say Y here to enable MMC Spec 4.2 and support Samsung
	  moviNAND.

config S3CMMC_DEBUG
	bool "To debug interface, enable all debug messages"
	depends on (MMC_S3C || HSMMC_S3C)
	help
	  Say Y here to enable Debug Messages.

config MMC_PXA
	tristate "Intel PXA25x/26x/27x Multimedia Card Interface support"
	depends on ARCH_PXA
	help
	  This selects the Intel(R) PXA(R) Multimedia card Interface.
	  If you have a PXA(R) platform with a Multimedia Card slot,
	  say Y or M here.

	  If unsure, say N.

config MMC_SDHCI
	tristate "Secure Digital Host Controller Interface support  (EXPERIMENTAL)"
	depends on PCI && EXPERIMENTAL
	help
	  This select the generic Secure Digital Host Controller Interface.
	  It is used by manufacturers such as Texas Instruments(R), Ricoh(R)
	  and Toshiba(R). Most controllers found in laptops are of this type.
	  If you have a controller with this interface, say Y or M here.

	  If unsure, say N.

config MMC_OMAP
	tristate "TI OMAP Multimedia Card Interface support"
	depends on ARCH_OMAP
	select TPS65010 if MACH_OMAP_H2
	help
	  This selects the TI OMAP Multimedia card Interface.
	  If you have an OMAP board with a Multimedia Card slot,
	  say Y or M here.

	  If unsure, say N.

config MMC_WBSD
	tristate "Winbond W83L51xD SD/MMC Card Interface support"
	depends on ISA_DMA_API
	help
	  This selects the Winbond(R) W83L51xD Secure digital and
          Multimedia card Interface.
	  If you have a machine with a integrated W83L518D or W83L519D
	  SD/MMC card reader, say Y or M here.

	  If unsure, say N.

config MMC_AU1X
	tristate "Alchemy AU1XX0 MMC Card Interface support"
	depends on SOC_AU1200
	help
	  This selects the AMD Alchemy(R) Multimedia card interface.
	  If you have a Alchemy platform with a MMC slot, say Y or M here.

	  If unsure, say N.

config MMC_AT91
	tristate "AT91 SD/MMC Card Interface support"
	depends on ARCH_AT91
	help
	  This selects the AT91 MCI controller.

	  If unsure, say N.

config MMC_IMX
	tristate "Motorola i.MX Multimedia Card Interface support"
	depends on ARCH_IMX
	help
	  This selects the Motorola i.MX Multimedia card Interface.
	  If you have a i.MX platform with a Multimedia Card slot,
	  say Y or M here.

	  If unsure, say N.

config MMC_TIFM_SD
	tristate "TI Flash Media MMC/SD Interface support  (EXPERIMENTAL)"
	depends on EXPERIMENTAL && PCI
	select TIFM_CORE
	help
	  Say Y here if you want to be able to access MMC/SD cards with
	  the Texas Instruments(R) Flash Media card reader, found in many
	  laptops.
	  This option 'selects' (turns on, enables) 'TIFM_CORE', but you
	  probably also need appropriate card reader host adapter, such as
	  'Misc devices: TI Flash Media PCI74xx/PCI76xx host adapter support
	  (TIFM_7XX1)'.

          To compile this driver as a module, choose M here: the
	  module will be called tifm_sd.
```

## sound/soc/codecs/Kconfig
```kconfig
config SND_SOC_AC97_CODEC
	tristate
	depends on SND_SOC

#add by wu
config SND_SOC_WM8580
	tristate
	depends on SND_SOC
#add end

config SND_SOC_WM8731
	tristate "wm8731 for s3c2416"
	depends on SND_SOC

config SND_SOC_WM8750
	tristate
	depends on SND_SOC

config SND_SOC_WM8753
	tristate
	depends on SND_SOC

#add by wu
config SND_SOC_WM8772
	tristate
	depends on SND_SOC
	
config SND_SOC_WM8990
	tristate
	depends on SND_SOC
#add end

config SND_SOC_WM9712
	tristate
	depends on SND_SOC

#add by wu
config SND_SOC_WM9713
	tristate
	depends on SND_SOC
#add end
```

## sound/soc/s3c/Kconfig
```kconfig
menu "SoC Audio for the Samsung S3C"

config SND_S3C_SOC
	tristate "SoC Audio for the Samsung S3C chips"
	depends on ARCH_S3C2410 && SND_SOC
	select SND_PCM
	help
	  Say Y or M if you want to add support for codecs attached to
	  the S3C AC97, I2S or SSP interface. You will also need
	  to select the audio interfaces to support below.

config SND_S3C_SOC_I2S
	tristate

config SND_S3C6400_SOC_I2S
	tristate

config SND_S3C6410_SOC_I2S
	tristate

config SND_S3C6410_SOC_PCMIF
	tristate

config SND_S3C2443_SOC_AC97
	tristate
	select AC97_BUS
	select SND_AC97_CODEC
	select SND_SOC_AC97_BUS
	
config SND_S3C24XX_SOC_SMDK2443_WM9710
	tristate "SoC AC97 Audio support for SMDK2443 - WM9710"
	depends on SND_S3C_SOC && MACH_SMDK2443
	select SND_S3C2443_SOC_AC97
	select SND_SOC_AC97_CODEC
	help
	  Say Y if you want to add support for SoC audio on smdk2443
	  with the WM9710.

config SND_S3C2450_SOC_AC97
	tristate
	select AC97_BUS
	select SND_AC97_CODEC
	select SND_SOC_AC97_BUS

config SND_S3C24XX_SOC_SMDK2450_WM9713
	tristate "SoC AC97 Audio support for SMDK2450 - WM9713"
	depends on SND_S3C_SOC && (CPU_S3C2450 || CPU_S3C2416)
	select SND_S3C2450_SOC_AC97
	select SND_SOC_WM9713
	help
	  Say Y if you want to add support for SoC audio on smdk2450
	  with the WM9713.

config SND_S3C6400_SOC_AC97
	tristate
	select AC97_BUS
	select SND_AC97_CODEC
	select SND_SOC_AC97_BUS

config SND_S3C64XX_SOC_SMDK6400_WM9713
	tristate "SoC AC97 Audio support for SMDK6400 - WM9713"
	depends on SND_S3C_SOC && MACH_SMDK6400
	select SND_S3C6400_SOC_AC97
	select SND_SOC_WM9713
	help
	  Say Y if you want to add support for SoC audio on smdk6400
	  with the WM9713.

config SND_S3C6410_SOC_AC97
	tristate
	select AC97_BUS
	select SND_AC97_CODEC
	select SND_SOC_AC97_BUS

config SND_S3C64XX_SOC_SMDK6410_WM9713
	tristate "SoC AC97 Audio support for SMDK6410 - WM9713"
	depends on SND_S3C_SOC && (MACH_SMDK6410)
	select SND_S3C6410_SOC_AC97
	select SND_SOC_WM9713
	help
	  Say Y if you want to add support for SoC audio on smdk6410
	  with the WM9713.
	
choice
        prompt "SMDK Record Path Select"
	depends on SND_S3C64XX_SOC_SMDK6400_WM9713 || SND_S3C24XX_SOC_SMDK2450_WM9713 || SND_S3C64XX_SOC_SMDK6410_WM9713

config SOUND_WM9713_INPUT_STREAM_LINE
	bool "Input Stream is LINE-IN"
	depends on SND_S3C64XX_SOC_SMDK6400_WM9713 || SND_S3C24XX_SOC_SMDK2450_WM9713 || SND_S3C64XX_SOC_SMDK6410_WM9713
	help
	  Say Y here to make input stream as LINE-IN.

config SOUND_WM9713_INPUT_STREAM_MIC
	bool "Input Stream is MIC"
	depends on SND_S3C64XX_SOC_SMDK6400_WM9713 || SND_S3C24XX_SOC_SMDK2450_WM9713 || SND_S3C64XX_SOC_SMDK6410_WM9713
	help
	  Say Y here to make input stream as MIC.
endchoice

config SND_S3C2450_SOC_I2S
	tristate

config SND_S3C2416_SOC_I2S
	tristate

config SND_SOC_I2S_V32
	tristate

config SND_SOC_I2S_V40
	tristate

config SND_S3C24XX_SOC_SMDK2450_WM8580
	tristate "SoC I2S Audio support for SMDK2450 - WM8580"
	depends on SND_S3C_SOC && (CPU_S3C2450 || CPU_S3C2416)
	select SND_S3C2450_SOC_I2S
	select SND_SOC_WM8580
	select SND_SOC_I2S_V40
	help
	  Say Y if you want to add support for SoC audio on smdk2450
	  with the WM8580.

config SND_S3C24XX_SOC_SMDK2450_WM8753
	tristate "SoC I2S Audio support for SMDK2450 - WM8753"
	depends on SND_S3C_SOC && CPU_S3C2450
	select SND_S3C2450_SOC_I2S
	select SND_SOC_WM8753
	select SND_SOC_I2S_V32
	help
	  Say Y if you want to add support for SoC audio on smdk2450
	  with the WM8753.
  
config SND_S3C64XX_SOC_SMDK6400_WM8990
	tristate "SoC I2S Audio support for SMDK6400 - WM8990"
	depends on SND_S3C_SOC && MACH_SMDK6400
	select SND_S3C_SOC_I2S
	select SND_SOC_WM8990
	help
	  Say Y if you want to add support for SoC audio on smdk6400
	  with the WM8990.

config SND_S3C24XX_SOC_SMDK2416_WM8753
	tristate "SoC I2S Audio support for SMDK2416 - WM8753"
	depends on SND_S3C_SOC && CPU_S3C2416
	select SND_S3C2416_SOC_I2S
	select SND_SOC_WM8753
	select SND_SOC_I2S_V32
	help
	  Say Y if you want to add support for SoC audio on smdk2416
	  with the WM8753.
  
config SND_S3C24XX_SOC_SMDK2416_WM8731
	tristate "SoC I2S Audio support for SMDK2416 - WM8731"
	depends on SND_S3C_SOC && CPU_S3C2416
	select SND_S3C2416_SOC_I2S
	select SND_SOC_WM8731
	select SND_SOC_I2S_V32
	help
	  Say Y if you want to add support for SoC audio on smdk2416
	  with the WM8731.

config SND_S3C64XX_SOC_SMDK6400_WM8990
	tristate "SoC I2S Audio support for SMDK6400 - WM8990"
	depends on SND_S3C_SOC && MACH_SMDK6400
	select SND_S3C_SOC_I2S
	select SND_SOC_WM8990
	help
	  Say Y if you want to add support for SoC audio on smdk6400
	  with the WM8990.


config SND_S3C64XX_SOC_SMDK6400_WM8753
	tristate "SoC I2S Audio support for SMDK6400 - WM8753"
	depends on SND_S3C_SOC && MACH_SMDK6400
	select SND_S3C_SOC_I2S
	select SND_SOC_WM8753
	help
	  Say Y if you want to add support for SoC audio on smdk6400
	  with the WM8753.
  
config SND_S3C64XX_SOC_SMDK6410_WM8753
	tristate "SoC I2S Audio support for SMDK6410 - WM8753"
	depends on SND_S3C_SOC && (MACH_SMDK6410)
	select SND_S3C_SOC_I2S
	select SND_SOC_WM8753
	help
	  Say Y if you want to add support for SoC audio on smdk6410
	  with the WM8753.

choice
        prompt "SMDK Record Path Select"
	depends on SND_S3C64XX_SOC_SMDK6400_WM8753 || SND_S3C64XX_SOC_SMDK6410_WM8753 || SND_S3C24XX_SOC_SMDK2450_WM8753 || SND_S3C24XX_SOC_SMDK2416_WM8753

config SOUND_WM8753_INPUT_STREAM_MIC_IN
	bool "Input Stream is MIC"
	depends on SND_S3C64XX_SOC_SMDK6400_WM8753 || SND_S3C64XX_SOC_SMDK6410_WM8753 || SND_S3C24XX_SOC_SMDK2450_WM8753 || SND_S3C24XX_SOC_SMDK2416_WM8753
	help
	  Say Y here to make input stream as MIC.

config SOUND_WM8753_INPUT_STREAM_LINE_IN
	depends on SND_S3C64XX_SOC_SMDK6400_WM8753 || SND_S3C64XX_SOC_SMDK6410_WM8753 || SND_S3C24XX_SOC_SMDK2450_WM8753 || SND_S3C24XX_SOC_SMDK2416_WM8753
	bool "Input Stream is LINE-IN"
	help
	  Say Y here to make input stream as LINE-IN.
endchoice

config SND_S3C64XX_SOC_SMDK6410_WM8580
	tristate "SoC I2S Audio support for SMDK6410 - WM8580"
	depends on SND_S3C_SOC && (MACH_SMDK6410)
	select SND_S3C6410_SOC_I2S
	select SND_SOC_WM8580
	help
	  Say Y if you want to add support for SoC audio on smdk6410
	  with the WM8580.

choice
        prompt "SMDK Record Path Select"
	depends on SND_S3C64XX_SOC_SMDK6410_WM8580

config SOUND_WM8580_INPUT_STREAM_LINE_IN
	bool "Input Stream is LINE-IN"
	depends on SND_S3C64XX_SOC_SMDK6410_WM8580
	help
	  Say Y here to make input stream as LINE-IN.

config SOUND_WM8580_INPUT_STREAM_MIC_IN
	bool "Input Stream is MIC"
	depends on SND_S3C64XX_SOC_SMDK6410_WM8580
	help
	  Say Y here to make input stream as MIC.
endchoice

config SND_S3C64XX_SOC_SMDK6400_WM8990
	tristate "SoC I2S Audio support for SMDK6400 - WM8990"
	depends on SND_S3C_SOC && MACH_SMDK6400
	select SND_S3C_SOC_I2S
	select SND_SOC_WM8990
	help
	  Say Y if you want to add support for SoC audio on smdk6400
	  with the WM8990.

config SND_S3C64XX_SOC_SMDK6410_WM8990
	tristate "SoC I2S Audio support for SMDK6410 - WM8990"
	depends on SND_S3C_SOC && (MACH_SMDK6410)
	select SND_S3C_SOC_I2S
	select SND_SOC_WM8990
	help
	  Say Y if you want to add support for SoC audio on smdk6410
	  with the WM8990.

choice
        prompt "SMDK Record Path Select"
	depends on SND_S3C64XX_SOC_SMDK6410_WM8990 || SND_S3C64XX_SOC_SMDK6400_WM8990

config SOUND_WM8990_INPUT_STREAM_LINE_IN
	bool "Input Stream is LINE-IN"
	depends on SND_S3C64XX_SOC_SMDK6410_WM8990 || SND_S3C64XX_SOC_SMDK6400_WM8990
	help
	  Say Y here to make input stream as LINE-IN.

config SOUND_WM8990_INPUT_STREAM_MIC_IN
	bool "Input Stream is MIC"
	depends on SND_S3C64XX_SOC_SMDK6410_WM8990 || SND_S3C64XX_SOC_SMDK6400_WM8990
	help
	  Say Y here to make input stream as MIC.
endchoice

config SND_S3C64XX_SOC_SMDK6410_WM8580_PCMIF
	tristate "SoC PCM Interface support for SMDK6410 - WM8580"
	depends on SND_S3C_SOC && MACH_SMDK6410
	select SND_S3C6410_SOC_PCMIF
	select SND_SOC_WM8580
	help
	  Say Y if you want to add support for SoC audio on smdk6410
	  with the WM8580.

endmenu
```
